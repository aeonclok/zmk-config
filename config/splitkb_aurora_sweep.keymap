/*
 * Copyright (c) 2022 The ZMK Contributors
 *
 * SPDX-License-Identifier: MIT
 */

// ┌─────┌─────┌─────┐   :set ve:all
// │     │     │     │   :VBox
// └─────└─────└─────┘

#include <behaviors.dtsi>
#include <dt-bindings/zmk/keys.h>
#include <dt-bindings/zmk/bt.h>
#include <dt-bindings/zmk/mouse.h>
#include <behaviors/num_word.dtsi> // requires auto-layer module

#include "zmk-helpers/helper.h"

#define WIN 0
#define MAC 1
#define NUM 2
#define NAV 3
#define MOUSE 5
#define HAKEA 6
#define REPEAT 7

#define AS(keycode) &as LS(keycode) keycode

#define KEYS_L 0 1 2 3 4 10 11 12 13 14 20 21 22 23 24
#define KEYS_R 5 6 7 8 9 15 16 17 18 19 25 26 27 28 29
#define KEYS_T 30 31 32 34  

#define COMBO_TERM_FAST 35
#define COMBO_TERM_SLOW 50
#define COMBO_GLOBAL_QUICKTAP 100

#define hmTAPPING_TERM 300
#define hmTAPPING_TERM_FAST 200

#define MACRO(_name_, _bindings_)          \
_name_: _name_##_macro {                   \
    compatible     = "zmk,behavior-macro"; \
    #binding-cells = <0>;                  \
    tap-ms         = <1>;                  \
    wait-ms        = <1>;                  \
    bindings       = <_bindings_>;         \
};

/ {
    macros {
        MACRO(backtick,  &kp LS(EQUAL) &kp SPACE)
        MACRO(caret,  &kp LS(RIGHT_BRACKET) &kp SPACE) 
        MACRO(tilde, &kp RA(RIGHT_BRACKET) &kp SPACE)
    };
};

#define MODMORPH(_name_, _bindings_, _bindings_shift_)               \
_name_: _name_##_modmorph {                                          \
    compatible = "zmk,behavior-mod-morph";                           \
    #binding-cells = <0>;                                            \
    bindings = <_bindings_>, <_bindings_shift_>;                     \
    mods = <(MOD_LSFT | MOD_RSFT)>;                                  \
};

#define COMBO(_name_, _bindings_, _key_positions_, _layers_)    \
combo_##_name_ {                                                \
    timeout-ms            = <COMBO_TERM_FAST>;                  \
    require-prior-idle-ms = <COMBO_GLOBAL_QUICKTAP>;            \
    bindings              = <_bindings_>;                       \
    key-positions         = <_key_positions_>;                  \
    layers                = <_layers_>;                         \
};

#define SMART_NUM &smart_num NUM 0
ZMK_HOLD_TAP(smart_num,
    flavor = "balanced";
    tapping-term-ms = <200>;
    quick-tap-ms = <175>;
    bindings = <&mo>, <&num_dance>;
)
ZMK_TAP_DANCE(num_dance,
    tapping-term-ms = <200>;
    bindings = <&num_word NUM>, <&sl NUM>;  // reverse this for sticky-num on single tap
)

#define MAKE_HRM(NAME, HOLD, TAP, TRIGGER_POS) \
    ZMK_HOLD_TAP(NAME, \
        flavor = "balanced"; \
        tapping-term-ms = <280>; \
        quick-tap-ms = <175>; \
        require-prior-idle-ms = <150>; \
        bindings = <HOLD>, <TAP>; \
        hold-trigger-key-positions = <TRIGGER_POS>; \
        hold-trigger-on-release; \
    )
MAKE_HRM(hml, &kp, &kp, KEYS_R KEYS_T)
MAKE_HRM(hmr, &kp, &kp, KEYS_L KEYS_T)

#define MAKE_HRMS(NAME, HOLD, TAP, TRIGGER_POS) \
    ZMK_HOLD_TAP(NAME, \
        flavor = "balanced"; \
        tapping-term-ms = <280>; \
        quick-tap-ms = <175>; \
        bindings = <HOLD>, <TAP>; \
        hold-trigger-key-positions = <TRIGGER_POS>; \
    )
MAKE_HRMS(hmls, &kp, &kp, KEYS_R KEYS_T)
MAKE_HRMS(hmrs, &kp, &kp, KEYS_L KEYS_T)

#define MAKE_HRMN(NAME, HOLD, TAP, TRIGGER_POS) \
    ZMK_HOLD_TAP(NAME, \
        flavor = "balanced"; \
        tapping-term-ms = <280>; \
        quick-tap-ms = <175>; \
        require-prior-idle-ms = <150>; \
        bindings = <HOLD>, <TAP>; \
        hold-trigger-key-positions = <TRIGGER_POS>; \
        hold-trigger-on-release; \
    )
MAKE_HRMN(hmln, &mo, &kp, KEYS_R KEYS_T)
MAKE_HRMN(hmrn, &mo, &kp, KEYS_L KEYS_T)


// tap: sticky-shift | shift + tap/ double-tap: caps-word | hold: shift
ZMK_MOD_MORPH(smart_shft,
    bindings = <&skq LSHFT>, <&caps_word>;
    mods = <(MOD_LSFT)>;
)
&caps_word {  // mods deactivate caps-word, requires PR #1451
    /delete-property/ ignore-modifiers;
};


// Alt+Tab swapper, requires PR #1366
ZMK_TRI_STATE(switcher_win,
    bindings = <&kt LALT>, <&kp TAB>, <&kt LALT>;
    ignored-key-positions = <12>, <1>;
)
ZMK_TRI_STATE(switcher_mac,
    bindings = <&kt LCMD>, <&kp TAB>, <&kt LCMD>;
    ignored-key-positions = <12>, <1>;
)
ZMK_TRI_STATE(quick_sw_win,
    bindings = <&kt LALT>, <&kp TAB>, <&kt LALT>;
)
ZMK_TRI_STATE(quick_sw_mac,
    bindings = <&kt LCMD>, <&kp TAB>, <&kt LCMD>;
)




// #define ZMK_MOUSE_DEFAULT_MOVE_VAL 1500  // 600
// #define ZMK_MOUSE_DEFAULT_SCRL_VAL 20    // 10


// Config from @caksoylar, defaults in comments
&mmv {
  acceleration-exponent = <1>;      // 1
  time-to-max-speed-ms = <500>;     // 300
  delay-ms = <0>;                   // 0
};

&msc {
  acceleration-exponent = <1>;      // 0
  time-to-max-speed-ms = <40>;      // 300
  delay-ms = <0>;                   // 0
};

#define U_MS_U &mmv MOVE_UP
#define U_MS_D &mmv MOVE_DOWN
#define U_MS_L &mmv MOVE_LEFT
#define U_MS_R &mmv MOVE_RIGHT
#define U_WH_U &msc SCRL_UP
#define U_WH_D &msc SCRL_DOWN
#define U_WH_L &msc SCRL_LEFT
#define U_WH_R &msc SCRL_RIGHT


// smart-mouse, requires PR #1366
// ZMK_TRI_STATE(smart_mouse,
//     bindings = <&tog MOUSE>, <&none>, <&tog MOUSE>;
//     ignored-key-positions = <LT1 LT3 RT0 RT1 RT2 RT3 RT4 RM1 RM2 RM3 RB1 RB2 RB3 RH0 RH1>;
//     ignored-layers = <MOUSE>;
// )



/ { 

//  ZMK_COMBO(name, bindings, keypos, layers, timeout, prior_idle, extra)

// 
// ╭─────────────┬─────────────┬─────────────┬─────────────┬─────────────╮    ╭─────────────┬─────────────┬─────────────┬─────────────┬─────────────╮
//            ┌─────┐       ┌─────┐       ┌─────┐       ┌─────┐                                                                                         
//            │  5  │       │  1  │       │  1  │       │  4  │
//            └──┬──┘    ┌──└──┬──┘──┐ ┌──└──┬──┘──┐ ┌──└──┬──┘──┐                                                                                      
// ├─────────────┼───────│  2  │3    │─│    3│2    │─│    4│2    │───────┤    ├─────────────┼─────────────┼─────────────┼─────────────┼─────────────┤
//            ┌─────┐    └──┌─────┐──┘ └──┌─────┐──┘ └──┌─────┐──┘                                                                                      
//            │  3  │       │  1  │       │  1  │       │  3  │
//            └──┬──┘    ┌──└──┬──┘──┐ ┌──└──┬──┘──┐ ┌──└──┬──┘──┐
// ├─────────────┼───────│  2  │3    │─│  2  │2    │─│    3│2    │───────┤    ├─────────────┼─────────────┼─────────────┼─────────────┼─────────────┤
//            ┌─────┐    └──┌─────┐──┘ └──┌─────┐──┘ └──┌─────┐──┘                                                                                      
//            │  4  │       │  2  │       │  2  │       │  3  │
//            └──┬──┘       └──┬──┘       └──┬──┘       └──┬──┘
// ╰─────────────┼─────────────┼─────────────┼─────────────┼─────────────┤    ├─────────────┼─────────────┼─────────────┼─────────────┼─────────────╯

    combos {
        compatible = "zmk,combos";

//        0             1             2             3             4                  5             6             7             8             9
//
//
//
// ╭─────────────┬─────────────┬─────────────┬─────────────┬─────────────╮    ╭─────────────┬─────────────┬─────────────┬─────────────┬─────────────╮                                                                                                                                 ──────┬─────────────┬─────────────┬───────────┬─────────────╮
//            ┌─────┐       ┌─────┐       ┌─────┐       ┌─────┐                          ┌─────┐       ┌─────┐       ┌─────┐       ┌─────┐
//        F   │hakea│   P   │ Tab │   L   │ { } │   H   │  €  │   B                  W   │     │   G   │ "   │   O   │  ?  │  . :  │     │   Q
//            └──┬──┘    ┌──└──┬──┘──┐ ┌──└──┬──┘──┐ ┌──└──┬──┘──┐                    ┌──└──┬──┘──┐ ┌──└──┬──┘──┐ ┌──└──┬──┘──┐    └──┬──┘
// ├─────────────┼───────│QckSw│Swtch│─│     │ [ ] │─│     │  @  │───────┤    ├───────│     │     │─│ ' ´ │     │─│     │  !  │───────┼─────────────┤                                                                                                                                 ──────┼─────────────┼─────────────┼─────────────┼─────────────┤
//            ┌─────┐    └──┌─────┐──┘ └──┌─────┐──┘ └──┌─────┐──┘                    └──┌─────┐──┘ └──┌─────┐──┘ └──┌─────┐──┘    ┌─────┐
//      7 S   │stnk1│ 5 T   │ Esc │ 3 N   │ ( ) │ 1 K   │     │   V                0 C   │     │ 2 U   │Rtrn │ 4 A   │Bs Dl│ 6 E   │     │ 8 I
//      Ctrl  └──┬──┘ Alt┌──└──┬──┘──Gui──└──┬──┘──Num──└──┬──┘──┐                    ┌──└──┬──┘──Num──└──┬──┘──Gui──└──┬──┘──┐Alt └──┬──┘ Ctrl
// ├─────────────┼───────│Copy │Paste│─│     │ < > │─│     │  $  │───────┤    ├───────│     │     │─│ = % │  :  │─│  |  │ / \ │───────┼─────────────┤                                                                                                                                 ──────┼─────────────┼─────────────┼─────────────┼─────────────┤
//            ┌─────┐    └──┌─────┐──┘ └──┌─────┐──┘ └──┌─────┐──┘                    └──┌─────┐──┘ └──┌─────┐──┘ └──┌─────┐──┘    ┌─────┐
//        J   │     │   D   │ ~ ^ │   R   │ & # │ 9 M   │     │   X                8 Z   │     │   Y   │ + * │   Ä   │ - _ │   Ö   │     │  , ;
//            └──┬──┘       └──┬──┘       └──┬──┘       └──┬──┘                          └──┬──┘       └──┬──┘       └──┬──┘       └──┬──┘
// ╰─────────────┼─────────────┼─────────────┼─────────────┼─────────────┤    ├─────────────┼─────────────┼─────────────┼─────────────┼─────────────╯                                                                                                                                 ──────┼─────────────┼─────────────┼─────────────┼─────────────╯
//
//                                               SmrtShft     Repeater           L2 + Space    L3 + Rtrn
//
//                                           ╰─────────────┼─────────────┤    ├─────────────┼─────────────╯
//
//
//
        // 1 and 1+2 row combos left hand
//        COMBO(tog_hakea,        &tog HAKEA,           0 1, WIN MAC NUM MOUSE NAV HAKEA REPEAT)
//        COMBO(tog_stnk1,        &tog REPEAT,           10 11, WIN MAC NUM MOUSE NAV HAKEA REPEAT)
        COMBO(TAB,              &kp TAB,              1 2, WIN MAC NUM MOUSE NAV HAKEA REPEAT)
        COMBO(br_curly_mac,     &mod_br_curly_mac,    2 3, MAC NUM MOUSE NAV HAKEA REPEAT)
        COMBO(br_curly_win,     &mod_br_curly_win,    2 3, WIN NUM MOUSE NAV HAKEA REPEAT)
        COMBO(euro_mac,         &kp LS(NUMBER_4),     3 4, MAC NUM MOUSE NAV HAKEA REPEAT)
        COMBO(euro_win,         &kp RA(E),            3 4, WIN NUM MOUSE NAV HAKEA REPEAT)
        COMBO(br_square,        &mod_br_square,       2 13, WIN MAC NUM MOUSE NAV HAKEA REPEAT)
        COMBO(at,               &kp RA(NUMBER_2),     3 14, WIN MAC NUM MOUSE NAV HAKEA REPEAT)
        COMBO(switcher_mac,     &switcher_mac,        1 12, MAC NUM MOUSE NAV HAKEA REPEAT)
        COMBO(quick_sw_mac,     &quick_sw_mac,        11 2, MAC NUM MOUSE NAV HAKEA REPEAT)
        COMBO(switcher_win,     &switcher_win,        1 12, WIN NUM MOUSE NAV HAKEA REPEAT)
        COMBO(quick_sw_win,     &quick_sw_win,        11 2, WIN NUM MOUSE NAV HAKEA REPEAT)
        
        // 1 and 1+2 row combos right hand
        COMBO(doublequote,      &kp LS(NUMBER_2),     6 7, WIN MAC NUM NAV HAKEA REPEAT)
        COMBO(question,         &kp LS(MINUS),        7 8, WIN MAC NUM NAV HAKEA REPEAT)
        COMBO(exclamation,      &kp LS(NUMBER_1),     7 18, WIN MAC NUM NAV HAKEA REPEAT)
        COMBO(squot_btick,      &mod_squot_btick,     16 7, WIN MAC NUM NAV HAKEA REPEAT)
        COMBO(copy_mac,         &kp LG(C),            15 6, MAC NUM NAV HAKEA REPEAT)
        COMBO(copy_win,         &kp LC(C),            16 7, WIN NUM NAV HAKEA REPEAT)

        // 2 and 2+3 row combos left hand
        COMBO(esc,              &kp ESC,              11 12, WIN MAC NUM MOUSE NAV HAKEA REPEAT)
        COMBO(br_round,         &mod_br_round,        12 13, WIN MAC NUM MOUSE NAV HAKEA REPEAT)
        COMBO(br_angled_mac,    &mod_br_angled_mac,   12 23, MAC NUM MOUSE NAV HAKEA REPEAT)
        COMBO(br_angled_win,    &mod_br_angled_win,   12 23, WIN NUM MOUSE NAV HAKEA REPEAT)
        COMBO(dollar,           &kp RA(NUMBER_4),     13 24, WIN MAC NUM MOUSE NAV HAKEA REPEAT)

        // 2 and 2+3 row combos right hand
        COMBO(enter,            &kp RET,              16 17, WIN MAC NUM NAV HAKEA REPEAT)
        COMBO(backspace_delete, &mod_bspc_del,        17 18, WIN MAC NUM NAV HAKEA REPEAT)
        COMBO(equals_percent,   &mod_equals_percent,  26 17, WIN MAC NUM NAV HAKEA REPEAT)
        COMBO(colon,            &kp LS(DOT),          27 16, WIN MAC NUM NAV HAKEA REPEAT)
        COMBO(mod_slashes_win,  &mod_slashes_win,     17 28, WIN NUM NAV HAKEA REPEAT)
        COMBO(mod_slashes_mac,  &mod_slashes_mac,     17 28, MAC NUM NAV HAKEA REPEAT)
        COMBO(pipe_mac,         &kp RA(NUMBER_7),     27 18, MAC NUM NAV HAKEA REPEAT)
        COMBO(pipe_win,         &kp RA(NON_US_BSLH),  27 18, WIN NUM NAV HAKEA REPEAT)
        COMBO(paste_mac,        &kp LG(V),            25 16, MAC NUM NAV HAKEA REPEAT)
        COMBO(paste_win,        &kp LC(V),            26 17, WIN NUM NAV HAKEA REPEAT)

        // 3 row combos left hand
        COMBO(amp_hash,         &mod_amp_hash,        22 23, WIN MAC NUM MOUSE NAV HAKEA REPEAT)
        COMBO(tilde_caret,      &mod_tilde_caret,     21 22, WIN MAC NUM MOUSE NAV HAKEA REPEAT)

        // 3 row combos right hand
        COMBO(plus_asterisk,    &mod_plus_asterisk,   26 27, WIN MAC NUM MOUSE NAV HAKEA REPEAT)
        COMBO(minus,            &kp SLASH,            27 28, WIN MAC NUM MOUSE NAV HAKEA REPEAT)
      
        // mixed combos
        COMBO(toggle_win_mac,   &tog MAC,             30 31 32 33, WIN MAC NUM MOUSE NAV HAKEA REPEAT)
        COMBO(toggle_mouse,     &tog MOUSE,           6 8, WIN MAC NUM MOUSE NAV HAKEA REPEAT)
        COMBO(toggle_num,       &tog NUM,             13 16, WIN MAC NUM MOUSE NAV HAKEA REPEAT)
        COMBO(toggle_unlock,    &studio_unlock,       4 5, WIN MAC NUM MOUSE NAV HAKEA REPEAT)

    };

    behaviors {
       skq: sticky_key_quick_release {
        compatible = "zmk,behavior-sticky-key";
        #binding-cells = <1>;
        bindings = <&kp>;
        release-after-ms = <1000>;
        quick-release;
        ignore-modifiers;
      };
        lt_bspc_del: layer_tap_backspace_delete {
            compatible = "zmk,behavior-hold-tap";
            #binding-cells = <2>;
            tapping-term-ms = <200>;
            //flavor = "tap-preferred";
            bindings = <&mo>, <&mod_bspc_del>;
        };
        MODMORPH(mod_br_curly_mac, &kp RA(RS(NUMBER_8)), &kp RA(RS(NUMBER_9)))
        MODMORPH(mod_br_curly_win, &kp RA(NUMBER_7), &kp RA(NUMBER_0))
        MODMORPH(mod_br_round, &kp LS(NUMBER_8), &kp LS(NUMBER_9))
        MODMORPH(mod_br_square, &kp RA(NUMBER_8), &kp RA(NUMBER_9))
        MODMORPH(mod_br_angled_win, &kp NON_US_BSLH, &kp LS(NON_US_BSLH))
        MODMORPH(mod_br_angled_mac, &kp GRAVE, &kp LS(GRAVE))
        MODMORPH(mod_bspc_del, &kp BACKSPACE, &kp DELETE)
        MODMORPH(mod_amp_hash, &kp LS(NUMBER_6), &kp LS(NUMBER_3))
        MODMORPH(mod_squot_btick, &kp BACKSLASH, &backtick)
        MODMORPH(mod_equals_percent, &kp LS(NUMBER_0), &kp LS(NUMBER_5))
        MODMORPH(mod_tilde_caret, &tilde, &caret)
        MODMORPH(mod_slashes_mac, &kp LS(NUMBER_7), &kp RA(LS(NUMBER_7)))
        MODMORPH(mod_slashes_win, &kp LS(NUMBER_7), &kp RA(MINUS))
        MODMORPH(mod_plus_asterisk, &kp MINUS ,&kp LS(BACKSLASH))

//      COMBO(amp,              &kp LS(NUMBER_6),     25 26, WIN MAC)
//      COMBO(colon,            &kp LS(DOT),          17 28, WIN MAC)
//      COMBO(percent,          &kp LS(NUMBER_5),     20 21, WIN MAC)
//      COMBO(tilde,            &tilde,               21 22, WIN MAC)
//      COMBO(equals,           &kp LS(NUMBER_0),     10 11, WIN MAC)
//      COMBO(backtick,         &backtick,            8 9, WIN MAC)
//      COMBO(hash,             &kp LS(NUMBER_3),     5 6, WIN MAC)
//      COMBO(caret,            &caret,               15 6, WIN MAC)
//      COMBO(slash,            &kp LS(NUMBER_7),     6 7, WIN MAC)
//      COMBO(backslash_win,    &kp RA(MINUS),        17 8, WIN)
//      COMBO(backslash_mac,    &kp RA(LS(NUMBER_7)), 17 8, MAC)
//      COMBO(singlequote,      &kp BACKSLASH,        18 19, WIN MAC)
    };

// 
// 
//      COMBOS:
// 
//            @    {}    €                    /   "
//        esc  tab   
//      =     !    ()    <>                   ?   '*
//      %     ~    []    $          &        +\   -_
// 
//      Home Row Mods:
//
//      CTRL ALT SHIFT                 SHIFT ALT CTRL    
// 
// 
//      DEFAULT LAYER:
// 
//      Q   D   J   P   G        F   R   U   Y   Ö 
//      A   L   S   T   K        H   N   E   I   O 
//      Z   X   C   V   B        W   M   Ä  .:  ,;
//                 TAB   <-   SPACE ENTER
// 
// 
  // most used vim keys:
  // esc, :, q
  // h, j, k, l
  // w, b, e
  // c, i, o, a
  // d, x
  // y, p
  // /, s, f, n
  // v

    keymap {
    compatible = "zmk,keymap";

   //  default_layer_win{
   //  bindings = <
   //  // ╭─────────────┬─────────────┬─────────────┬─────────────┬─────────────╮    ╭─────────────┬─────────────┬─────────────┬─────────────┬─────────────╮
   //      &kp Q         &hml RALT D   &kp J         &kp P         &kp G              &kp F         &kp R         &kp U         &hmr RALT Y   &kp SEMI 
   //  // ├─────────────┼─────────────┼─────────────┼─────────────┼─────────────┤    ├─────────────┼─────────────┼─────────────┼─────────────┼─────────────┤
   //      &hml LCTRL A  &hml LALT L   &hml LGUI S   &hmln 2 T     &kp K              &kp H         &hmrn 2 N     &hmr RGUI E   &hmr LALT I   &hmr RCTRL O
   //  // ├─────────────┼─────────────┼─────────────┼─────────────┼─────────────┤    ├─────────────┼─────────────┼─────────────┼─────────────┼─────────────┤
   //      &kp Z         &kp X         &kp C         &kp V         &kp B              &kp W         &kp M         &kp SQT       &kp DOT       &kp COMMA
   //  // ╰─────────────┼─────────────┼─────────────┼─────────────┼─────────────┤    ├─────────────┼─────────────┼─────────────┼─────────────┼─────────────╯
   //                                                SMART_NUM     &smart_shft        &lt 3 SPACE   &mo 3
   //  //                                           ╰─────────────┼─────────────┤    ├─────────────┼─────────────╯
   //  >;
   //  };


    default_layer_win{
    bindings = <
    // ╭─────────────┬─────────────┬─────────────┬─────────────┬─────────────╮    ╭─────────────┬─────────────┬─────────────┬─────────────┬─────────────╮
        &kp F         &hml RALT P   &kp L         &kp H         &kp B              &kp W         &kp G         &kp O         &hmr RALT DOT &kp Q 
    // ├─────────────┼─────────────┼─────────────┼─────────────┼─────────────┤    ├─────────────┼─────────────┼─────────────┼─────────────┼─────────────┤
        &hml LCTRL S  &hml LALT T   &hml LGUI N   &hmln 2 K     &kp V              &kp C         &hmrn 2 U     &hmr RGUI A   &hmr LALT E   &hmr RCTRL I
    // ├─────────────┼─────────────┼─────────────┼─────────────┼─────────────┤    ├─────────────┼─────────────┼─────────────┼─────────────┼─────────────┤
        &kp J         &kp D         &kp R         &kp M         &kp X              &kp Z         &kp Y         &kp SQT       &kp SEMI      &kp COMMA
    // ╰─────────────┼─────────────┼─────────────┼─────────────┼─────────────┤    ├─────────────┼─────────────┼─────────────┼─────────────┼─────────────╯
                                                  &smart_shft   &key_repeat        &lt 3 SPACE   &mo 3
    //                                           ╰─────────────┼─────────────┤    ├─────────────┼─────────────╯
    >;
    };


    default_layer_mac {
    bindings = <
    // ╭─────────────┬─────────────┬─────────────┬─────────────┬─────────────╮    ╭─────────────┬─────────────┬─────────────┬─────────────┬─────────────╮
        &trans        &trans        &trans        &trans        &trans             &trans        &trans        &trans        &trans        &trans
    // ├─────────────┼─────────────┼─────────────┼─────────────┼─────────────┤    ├─────────────┼─────────────┼─────────────┼─────────────┼─────────────┤
        &trans        &trans        &trans        &trans        &trans             &trans        &trans        &trans        &trans        &trans
    // ├─────────────┼─────────────┼─────────────┼─────────────┼─────────────┤    ├─────────────┼─────────────┼─────────────┼─────────────┼─────────────┤
        &trans        &trans        &trans        &trans        &trans             &trans        &trans        &trans        &trans        &trans
    // ╰─────────────┼─────────────┼─────────────┼─────────────┼─────────────┤    ├─────────────┼─────────────┼─────────────┼─────────────┼─────────────╯
                                                  &trans        &trans             &trans        &trans
    //                                           ╰─────────────┼─────────────┤    ├─────────────┼─────────────╯
    >;
    };

    left_layer {
    bindings = <
    // ╭─────────────┬─────────────┬─────────────┬─────────────┬─────────────╮    ╭─────────────┬─────────────┬─────────────┬─────────────┬─────────────╮
        &trans        &trans        &trans        &trans        &trans             &trans        &trans        &trans        &trans        &trans
    // ├─────────────┼─────────────┼─────────────┼─────────────┼─────────────┤    ├─────────────┼─────────────┼─────────────┼─────────────┼─────────────┤
        &hml LCTRL N7 &hml LALT N5  &hml LGUI N3 &hmls LSHFT N1 &trans             &kp RA(N4)    &hmrs RSHFT N0 &hmr RGUI N2  &hmr LALT N4  &hmr RCTRL N6
    // ├─────────────┼─────────────┼─────────────┼─────────────┼─────────────┤    ├─────────────┼─────────────┼─────────────┼─────────────┼─────────────┤
        &trans        &trans        &trans        &kp N9        &trans             &trans        &kp N8        &trans        &trans        &trans
    // ╰─────────────┼─────────────┼─────────────┼─────────────┼─────────────┤    ├─────────────┼─────────────┼─────────────┼─────────────┼─────────────╯
                                                  &mo 2         &trans             &kp SPACE     &lt 4 RET 
    //                                           ╰─────────────┼─────────────┤    ├─────────────┼─────────────╯
    >;
    };

    right_layer {
    bindings = <
    // ╭─────────────┬─────────────┬─────────────┬─────────────┬─────────────╮    ╭─────────────┬─────────────┬─────────────┬─────────────┬─────────────╮
        &trans        &trans        &trans        &trans        &trans             &trans        &trans        &kp UP        &trans        &trans
    // ├─────────────┼─────────────┼─────────────┼─────────────┼─────────────┤    ├─────────────┼─────────────┼─────────────┼─────────────┼─────────────┤
        &trans        &trans        &trans        &trans        &trans             &kp RA(N4)    &kp LEFT      &kp DOWN      &kp RIGHT     &trans
    // ├─────────────┼─────────────┼─────────────┼─────────────┼─────────────┤    ├─────────────┼─────────────┼─────────────┼─────────────┼─────────────┤
        &trans        &trans        &trans        &trans        &trans             &trans        &kp PAGE_UP   &trans        &kp PAGE_DOWN &trans
    // ╰─────────────┼─────────────┼─────────────┼─────────────┼─────────────┤    ├─────────────┼─────────────┼─────────────┼─────────────┼─────────────╯
                                                  &mo 4         &kp LCTRL          &kp SPACE     &mo 3 
    //                                           ╰─────────────┼─────────────┤    ├─────────────┼─────────────╯
    >;
    };  

    tri_layer {
    bindings = <
    // ╭─────────────┬─────────────┬─────────────┬─────────────┬─────────────╮    ╭─────────────┬─────────────┬─────────────┬─────────────┬─────────────╮
        &kp N1        &kp N2        &kp N3        &kp N4        &kp N5             &bt BT_SEL 1  &bt BT_SEL 2  &bt BT_SEL 3  &bt BT_SEL 4  &bt BT_SEL 5
    // ├─────────────┼─────────────┼─────────────┼─────────────┼─────────────┤    ├─────────────┼─────────────┼─────────────┼─────────────┼─────────────┤
        &kp F1        &kp F2        &kp F3        &kp F4        &kp F5             &trans        &kp PG_UP     &kp K_VOL_UP  &kp K_MUTE    &trans 
    // ├─────────────┼─────────────┼─────────────┼─────────────┼─────────────┤    ├─────────────┼─────────────┼─────────────┼─────────────┼─────────────┤
        &bt BT_CLR    &bt BT_NXT    &bt BT_PRV    &kp F6        &kp F7             &trans        &kp PG_DN     &kp K_VOL_DN  &trans        &trans   
    // ╰─────────────┼─────────────┼─────────────┼─────────────┼─────────────┤    ├─────────────┼─────────────┼─────────────┼─────────────┼─────────────╯
                                                  &trans        &trans             &trans        &trans 
        //                                       ╰─────────────┼─────────────┤    ├─────────────┼─────────────╯
    >;
    };

    mouse_layer {
    bindings = <
    // ╭─────────────┬─────────────┬─────────────┬─────────────┬─────────────╮    ╭─────────────┬─────────────┬─────────────┬─────────────┬─────────────╮
        &trans        &trans        &trans        &trans        &trans             U_WH_L        U_WH_U        U_MS_U        U_WH_D        U_WH_R
    // ├─────────────┼─────────────┼─────────────┼─────────────┼─────────────┤    ├─────────────┼─────────────┼─────────────┼─────────────┼─────────────┤
        &trans        &trans        &trans        &trans        &trans             &trans        U_MS_L        U_MS_D        U_MS_R        &trans
    // ├─────────────┼─────────────┼─────────────┼─────────────┼─────────────┤    ├─────────────┼─────────────┼─────────────┼─────────────┼─────────────┤
        &trans        &trans        &trans        &trans        &trans             &trans        &trans        &trans        &trans        &trans
    // ╰─────────────┼─────────────┼─────────────┼─────────────┼─────────────┤    ├─────────────┼─────────────┼─────────────┼─────────────┼─────────────╯
                                                  &trans        &trans             &mkp LCLK     &mkp RCLK
    //                                           ╰─────────────┼─────────────┤    ├─────────────┼─────────────╯
    >;
    };

//  h p l m .  w , o ä z
//  s t n k j  c u e a i
//  b g r v d  f y ö x '
                 
    hakea_finnish {
    bindings = <
    // ╭─────────────┬─────────────┬─────────────┬─────────────┬─────────────╮    ╭─────────────┬─────────────┬─────────────┬─────────────┬─────────────╮
        &kp H         &hml RALT P   &kp L         &kp M         &kp DOT            &kp W         &kp COMMA     &kp O         &hmr RALT SQT &kp Z 
    // ├─────────────┼─────────────┼─────────────┼─────────────┼─────────────┤    ├─────────────┼─────────────┼─────────────┼─────────────┼─────────────┤
        &hml LCTRL S  &hml LALT T   &hml LGUI N   &hmln 2 K     &kp J              &kp C         &hmrn 2 U     &hmr RGUI E   &hmr LALT A   &hmr RCTRL I
    // ├─────────────┼─────────────┼─────────────┼─────────────┼─────────────┤    ├─────────────┼─────────────┼─────────────┼─────────────┼─────────────┤
        &kp B         &kp G         &kp R         &kp V         &kp D              &kp F         &kp Y         &kp SEMI      &kp X         &kp Q
    // ╰─────────────┼─────────────┼─────────────┼─────────────┼─────────────┤    ├─────────────┼─────────────┼─────────────┼─────────────┼─────────────╯
                                                  &trans        &trans             &trans        &trans
    //                                           ╰─────────────┼─────────────┤    ├─────────────┼─────────────╯
    >;
    };

     
    repeater {
    bindings = <
    // ╭─────────────┬─────────────┬─────────────┬─────────────┬─────────────╮    ╭─────────────┬─────────────┬─────────────┬─────────────┬─────────────╮
        &trans        &trans        &trans        &trans        &trans             &trans        &trans        &trans        &trans        &trans
    // ├─────────────┼─────────────┼─────────────┼─────────────┼─────────────┤    ├─────────────┼─────────────┼─────────────┼─────────────┼─────────────┤
        &trans        &trans        &trans        &trans        &trans             &trans        &trans        &trans        &trans        &trans
    // ├─────────────┼─────────────┼─────────────┼─────────────┼─────────────┤    ├─────────────┼─────────────┼─────────────┼─────────────┼─────────────┤
        &trans        &trans        &trans        &trans        &trans             &trans        &trans        &trans        &trans        &trans
    // ╰─────────────┼─────────────┼─────────────┼─────────────┼─────────────┤    ├─────────────┼─────────────┼─────────────┼─────────────┼─────────────╯
                                                  &smart_shft   &key_repeat
             &trans        &trans
    //                                           ╰─────────────┼─────────────┤    ├─────────────┼─────────────╯
    >;
    };
  };
};
